## CMakeLists.txt
```
cmake_minimum_required(VERSION 3.20.0)

find_package(Zephyr REQUIRED HINTS $ENV{ZEPHYR_BASE})
project(zephyr_posix_newlib)

target_sources(app PRIVATE src/main.c)
```

## prj.conf
```kconfig
# CONFIG_POSIX_API=y
CONFIG_NEWLIB_LIBC=y
```

## src/main.c
```c
#include <unistd.h>
#include <stdio.h>

int main(void)
{
	printf("isatty %d\n", isatty(0));

	return 0;
}
```
